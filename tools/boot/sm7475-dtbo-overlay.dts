// SPDX-License-Identifier: BSD-3-Clause
/*
 * SM7475 / Realme GT Neo5 SE (RMX3700) 专用 dtbo overlay。
 *
 * 为什么不用自建 DTB：实测该机 bootloader 只接受「与原厂逐字节一致」的
 * vendor_boot DTB 区域，任何替换（哪怕只换其中一份 DTB）都会直接放弃引导、
 * 秒回 fastboot。所以 vendor_boot 保持原厂原样，我们只通过 dtbo overlay
 * 往原厂 base DTB 里注入内核需要的节点（这里是 simple-framebuffer）。
 *
 * 两个实测要点：
 *  1. dtbo 分区必须带 AVB footer（add_hash_footer），否则 bootloader 拒绝；
 *  2. overlay 的 fragment 必须用 target = <&symbol> 引用原厂 base DTB 的
 *     /__symbols__；实测 target-path = "/" 不被支持。
 *     原厂 base DTB 里 chosen = "/chosen"，故用 <&chosen>。
 */
/dts-v1/;
/plugin/;

/ {
	/* 与原厂 overlay 的匹配属性保持一致，确保能被选中 */
	qcom,pmic-id = <47 0 0 0 0 0 0 0 65 65>;
	qcom,pmic-id-size = <10>;
	model = "Qualcomm Technologies, Inc. Ukee MTP, Senna A";
	compatible = "qcom,ukee-mtp", "qcom,ukee", "qcom,mtp";
	qcom,msm-id = <0x24f 0x10000>;
	qcom,board-id = <0x10008 0>;
	oplus,project-id = <22737 22623>;

	/* 往原厂 /chosen 里塞入 simple-framebuffer，让 simplefb 接管开机 logo
	 * 所在的扫描缓冲，从而在内核启动早期就能在屏幕上看到 dmesg。 */
	fragment@0 {
		target-path = "/chosen";
		__overlay__ {
			/* 显式声明 cell 数：原厂 base DTB 的 /chosen 本身没有
			 * #address-cells/#size-cells，靠继承 root 的 2/2。overlay 里
			 * 不写清，dtc 会按默认的 2/1 解析下面的 reg（之前报 reg_format
			 * warning 就是这个），framebuffer 的地址/长度就取错了。 */
			#address-cells = <2>;
			#size-cells = <2>;

			/* 实测：boot 头里的 cmdline 不一定进内核（Android 的 cmdline
			 * 实际来自 DTB /chosen/bootargs，由 bootloader 写入），所以这里
			 * 直接往 /chosen 里塞 bootargs，确保 console=tty0 生效。 */
			bootargs = "console=tty0 console=ttyMSM0,115200n8 loglevel=8 ignore_loglevel clk_ignore_unused regulator_ignore_unused";

			framebuffer@b8000000 {
				compatible = "simple-framebuffer";
				reg = <0x0 0xb8000000 0x0 0x2b00000>;
				width = <1240>;
				height = <2772>;
				stride = <4960>;
				format = "a8r8g8b8";
			};
		};
	};

	fragment@1 {
		target = <&ramoops_mem>;
		__overlay__ {
			reg = <0x09 0x7a5c0000 0x00 0x00240000>;
			no-map;
			record-size = <0x00080000>;
			console-size = <0x00040000>;
			pmsg-size = <0x00040000>;
		};
	};
};
